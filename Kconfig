## Kconfig
```kconfig
# SPDX-License-Identifier: Apache-2.0
# OmniCAN — Unified multi-protocol CAN stack for Zephyr RTOS
# Copyright (c) 2026 BitConcepts, LLC

menuconfig OMNICAN
	bool "OmniCAN multi-protocol CAN stack"
	depends on CAN
	select NET_BUF
	help
	  Enable OmniCAN — a unified multi-protocol CAN stack for Zephyr.
	  Supports CANopen, CANopen FD, SAE J1939, ISO 14229 (UDS),
	  and SAE J1979 (OBD-II).

if OMNICAN

# ---------------------------------------------------------------------------
# Protocol modules
# ---------------------------------------------------------------------------

config OMNICAN_CANOPEN
	bool "CANopen (CiA 301)"
	default n
	help
	  Enable the CANopen protocol stack (CiA 301).
	  Includes NMT, SDO server, PDO, Emergency, Heartbeat.

config OMNICAN_CANOPEN_FD
	bool "CANopen FD (CiA 1301)"
	depends on OMNICAN_CANOPEN && CAN_FD_MODE
	default n
	help
	  Enable CANopen FD extensions (CiA 1301) on top of CANopen.
	  Requires CAN FD hardware and OMNICAN_CANOPEN.

config OMNICAN_J1939
	bool "SAE J1939"
	select CAN_ACCEPT_RTR
	default n
	help
	  Enable SAE J1939 support: address claiming (J1939/81),
	  PGN routing (J1939/21), and Transport Protocol (J1939/21 TP/ETP).
	  Uses 29-bit extended CAN identifiers.

config OMNICAN_UDS
	bool "ISO 14229 / UDS (Unified Diagnostic Services)"
	depends on ISOTP
	default n
	help
	  Enable ISO 14229 UDS server and client.
	  Core services: 0x10 DiagnosticSessionControl,
	  0x11 ECUReset, 0x22 ReadDataByIdentifier,
	  0x27 SecurityAccess, 0x28 CommunicationControl,
	  0x2E WriteDataByIdentifier, 0x31 RoutineControl,
	  0x34/0x36/0x37 RequestDownload/TransferData/RequestTransferExit,
	  0x3E TesterPresent, 0x85 ControlDTCSetting.
	  Transport: Zephyr ISO-TP (ISO 15765-2).

config OMNICAN_OBD2
	bool "SAE J1979 / OBD-II"
	depends on ISOTP
	default n
	help
	  Enable OBD-II (SAE J1979) PID query/response support.
	  Supports Mode 0x01..0x09. Transport: Zephyr ISO-TP (ISO 15765-4).

# ---------------------------------------------------------------------------
# Core frame router
# ---------------------------------------------------------------------------

config OMNICAN_FRAME_ROUTER
	bool
	default y if (OMNICAN_CANOPEN || OMNICAN_J1939 || OMNICAN_UDS || OMNICAN_OBD2)
	help
	  Internal: enable the CAN frame router when any protocol is active.

# ---------------------------------------------------------------------------
# ISOTP patch (Zephyr #86025 workaround)
# ---------------------------------------------------------------------------

config OMNICAN_ISOTP_PATCH
	bool "Apply Zephyr ISOTP same-ID bind/send workaround"
	depends on ISOTP && (OMNICAN_UDS || OMNICAN_OBD2)
	default y if OMNICAN_UDS || OMNICAN_OBD2
	help
	  Enables the OmniCAN workaround for Zephyr ISOTP issue #86025:
	  cannot bind and transmit on the same CAN ID. Required for
	  standard UDS physical addressing (e.g. 0x7E0/0x7E8).

# ---------------------------------------------------------------------------
# Logging
# ---------------------------------------------------------------------------

module = OMNICAN
module-str = OmniCAN
source "$(ZEPHYR_BASE)/subsys/logging/Kconfig.template.log_config"

endif # OMNICAN
```

## west.yml
```yaml
manifest:
  version: "0.13"

  self:
    path: omnican
    # west-commands: scripts/west-commands.yml  # Uncomment when custom commands exist

  defaults:
    remote: zephyr

  remotes:
    - name: zephyr
      url-base: https://github.com/zephyrproject-rtos
    - name: bitconcepts
      url-base: https://github.com/BitConcepts

  projects:
    # Zephyr RTOS (pinned to a stable release — update as needed)
    - name: zephyr
      remote: zephyr
      revision: v3.7.0
      import: true

    # CANopenNode upstream — used as source reference for the CANopen module.
    # OmniCAN does NOT vendor CANopenNode directly; instead src/canopen/
    # contains a clean re-implementation guided by upstream.
    # Kept here as a dependency reference for OD generation tools.
    - name: CANopenNode
      url: https://github.com/CANopenNode/CANopenNode
      revision: master
      path: modules/lib/canopennode
      groups:
        - optional

    # Open-SAE-J1939 — MIT-licensed C J1939 reference implementation.
    # Primary alternate source for J1939/73 DM1-DM16 implementation guidance
    # and ISO 11783-7 auxiliary valve messaging. Not vendored directly;
    # used as reference during OmniCAN src/j1939/ implementation.
    - name: Open-SAE-J1939
      url: https://github.com/DanielMartensson/Open-SAE-J1939
      revision: main
      path: modules/lib/open-sae-j1939
      groups:
        - optional
        - j1939-ref

    # AgIsoStack++ — MIT-licensed C++ ISOBUS (ISO 11783) reference library.
    # Used as PROTOCOL REFERENCE ONLY during OmniCAN Phase 6 development.
    # NOT integrated into Zephyr: uses C++11 STL (std::vector, std::shared_ptr),
    # POSIX threads (std::thread), and dynamic allocation — incompatible with
    # OmniCAN's static-allocation, zero-overhead model. OmniCAN Phase 6 is a
    # native Zephyr C re-implementation using AgIsoStack++ as reference.
    # Fetch locally for reference: west update --group isobus-ref
    - name: AgIsoStack
      url: https://github.com/Open-Agriculture/AgIsoStack-plus-plus
      revision: main
      path: modules/lib/agisostack
      groups:
        - optional
        - isobus-ref
```
